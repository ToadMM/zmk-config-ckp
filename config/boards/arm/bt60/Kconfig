## config/boards/arm/bt60/Kconfig
```kconfig
# SPDX-License-Identifier: MIT

config BOARD_ENABLE_DCDC
	bool "Enable DCDC mode"
	select SOC_DCDC_NRF52X
	default y
	depends on BOARD_BT60
	
config ZMK_SLEEP
	bool "y"
config ZMK_IDLE_TIMEOUT
	int "30000"
```
